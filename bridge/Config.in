## bridge/Config.in
```kconfig
# Adds this external tree's packages to Buildroot's menuconfig (under "External options").
source "$BR2_EXTERNAL_ARTLYNK_BRIDGE_PATH/package/artlynk-view/Config.in"
```

## bridge/configs/artlynk_bridge_defconfig
```kconfig
# ArtLynk Bridge — Buildroot defconfig for the Radxa Zero (Amlogic S905Y2 / G12A, Cortex-A53).
# Build with:  make BR2_EXTERNAL=<.../bridge> artlynk_bridge_defconfig && make
# This is a *starting* config — the two TODO areas (Amlogic boot firmware, HEVC decoder) are noted
# inline and in the README; expect to iterate with `make menuconfig`.

# --- Architecture -----------------------------------------------------------
BR2_aarch64=y
BR2_cortex_a53=y

# --- Toolchain: pre-built Bootlin (aarch64 glibc) ---------------------------
# Why external instead of a Buildroot-built toolchain: it has glibc + recent kernel headers baked in
# (no strict headers-match check, the thing that kept forcing uClibc/2.6), AND it skips compiling a
# whole toolchain — by far the longest, most memory-hungry phase. Much faster + more robust.
# (If this exact symbol differs on your Buildroot release, set it via `build.sh menuconfig`:
#  Toolchain -> Toolchain type: External -> Bootlin toolchains -> aarch64 glibc.)
BR2_TOOLCHAIN_EXTERNAL=y
BR2_TOOLCHAIN_EXTERNAL_BOOTLIN=y
BR2_TOOLCHAIN_EXTERNAL_BOOTLIN_AARCH64_GLIBC_STABLE=y

# --- System / init ----------------------------------------------------------
BR2_TARGET_GENERIC_HOSTNAME="artlynk-bridge"
BR2_TARGET_GENERIC_ISSUE="ArtLynk Bridge"
BR2_TARGET_GENERIC_ROOT_PASSWD="artlynk"
BR2_INIT_BUSYBOX=y
BR2_SYSTEM_BIN_SH_BUSYBOX=y
# eudev (not mdev): provides BR2_PACKAGE_HAS_UDEV so libgudev builds — required by gst uvcsink.
BR2_ROOTFS_DEVICE_CREATION_DYNAMIC_EUDEV=y
BR2_TARGET_GENERIC_GETTY_PORT="ttyAML0"          # Amlogic serial console
# our overlay files (init scripts + config) get laid straight onto the rootfs:
BR2_ROOTFS_OVERLAY="$(BR2_EXTERNAL_ARTLYNK_BRIDGE_PATH)/board/radxa-zero/rootfs-overlay"
# after the rootfs is built: fix up WiFi nvram + drop stale files, then assemble the SD image:
BR2_ROOTFS_POST_BUILD_SCRIPT="$(BR2_EXTERNAL_ARTLYNK_BRIDGE_PATH)/board/radxa-zero/post-build.sh"
BR2_ROOTFS_POST_IMAGE_SCRIPT="$(BR2_EXTERNAL_ARTLYNK_BRIDGE_PATH)/board/radxa-zero/post-image.sh"
BR2_ROOTFS_POST_SCRIPT_ARGS="$(BR2_EXTERNAL_ARTLYNK_BRIDGE_PATH)/board/radxa-zero/genimage.cfg"

# --- Kernel: mainline + Radxa Zero device tree + our extra options ----------
BR2_LINUX_KERNEL=y
BR2_LINUX_KERNEL_CUSTOM_VERSION=y
BR2_LINUX_KERNEL_CUSTOM_VERSION_VALUE="6.6.30"
BR2_LINUX_KERNEL_USE_ARCH_DEFAULT_CONFIG=y         # arm64 defconfig
BR2_LINUX_KERNEL_DTS_SUPPORT=y
BR2_LINUX_KERNEL_INTREE_DTS_NAME="amlogic/meson-g12a-radxa-zero"
BR2_LINUX_KERNEL_NEEDS_HOST_OPENSSL=y
# extra options: USB CDC-ECM *host*, DRM/KMS (meson), V4L2 + Amlogic VDEC (HEVC) — see file:
BR2_LINUX_KERNEL_CONFIG_FRAGMENT_FILES="$(BR2_EXTERNAL_ARTLYNK_BRIDGE_PATH)/board/radxa-zero/linux.fragment"
# f_uvc bulk video-streaming endpoint support (mainline is ISOC-only; Amlogic dwc2 can't sustain ISOC IN):
BR2_LINUX_KERNEL_PATCH="$(BR2_EXTERNAL_ARTLYNK_BRIDGE_PATH)/board/radxa-zero/patches/linux/0001-uvc-bulk-mode.patch"

# --- Bootloader: mainline U-Boot for radxa-zero -----------------------------
# TODO(amlogic-fip): U-Boot alone is not bootable on Amlogic — it must be wrapped with the signed
# firmware chain (BL2/BL31 + aml_encrypt_g12a). See post-image.sh / README. Until then, boot from a
# vendor/CoreELEC bootloader already on the eMMC/SD and just provide kernel+rootfs.
BR2_TARGET_UBOOT=y
BR2_TARGET_UBOOT_BUILD_SYSTEM_KCONFIG=y
BR2_TARGET_UBOOT_CUSTOM_VERSION=y
BR2_TARGET_UBOOT_CUSTOM_VERSION_VALUE="2024.04"
BR2_TARGET_UBOOT_BOARD_DEFCONFIG="radxa-zero"
BR2_TARGET_UBOOT_NEEDS_DTC=y
# host mkimage — post-image.sh uses it to compile boot.cmd -> boot.scr
BR2_PACKAGE_HOST_UBOOT_TOOLS=y

# --- Filesystem: ext4 rootfs + a FAT boot partition (genimage builds sdcard.img) -
# NB: the symbol is ROOTFS_EXT2 (the ext2/3/4 builder) + the _4 revision for ext4 — there is no
# BR2_TARGET_ROOTFS_EXT4. Output file is rootfs.ext2 (an ext4 image), which genimage.cfg references.
BR2_TARGET_ROOTFS_EXT2=y
BR2_TARGET_ROOTFS_EXT2_4=y
# default is ~60M — far too small for GStreamer + ffmpeg + the generic arm64 kernel's modules.
# (Later we can shrink this a lot with a trimmed kernel config; 1G is roomy for now.)
BR2_TARGET_ROOTFS_EXT2_SIZE="1G"
BR2_PACKAGE_HOST_GENIMAGE=y
BR2_PACKAGE_HOST_DOSFSTOOLS=y
BR2_PACKAGE_HOST_MTOOLS=y

# --- Video stack: GStreamer -> KMS/DRM (no X/Wayland) -----------------------
BR2_PACKAGE_LIBDRM=y
BR2_PACKAGE_GSTREAMER1=y
BR2_PACKAGE_GST1_PLUGINS_BASE=y
BR2_PACKAGE_GST1_PLUGINS_GOOD=y
BR2_PACKAGE_GST1_PLUGINS_GOOD_V4L2=y                # V4L2 (stateless HEVC decoder lives here)
BR2_PACKAGE_GST1_PLUGINS_BAD=y
BR2_PACKAGE_GST1_PLUGINS_BAD_PLUGIN_KMS=y           # kmssink -> direct to HDMI framebuffer
BR2_PACKAGE_GST1_LIBAV=y                            # avdec_h265 (software fallback, M2)
# uvcsink lives in gst1-plugins-bad's 'uvcgadget' plugin, which Buildroot has no Kconfig symbol for and
# force-disables (-Duvcgadget=disabled). build.sh flips that meson flag; the plugin needs libgudev:
BR2_PACKAGE_LIBGUDEV=y                              # gudev-1.0 — build+runtime dep of uvcsink

# --- Userspace tools --------------------------------------------------------
BR2_PACKAGE_DROPBEAR=y                              # ssh in for development
BR2_PACKAGE_HTOP=y

# --- WiFi (SSH-over-WiFi management; the composite/UVC gadget breaks ECM, so WiFi is the mgmt link) ---
# Chip is the Ampak AP6212 (BCM43430); firmware blob is in linux-firmware, but its nvram ships as
# brcmfmac43430-sdio.AP6212.txt while the driver wants brcmfmac43430-sdio.txt -> post-build.sh renames it.
BR2_PACKAGE_LINUX_FIRMWARE=y
BR2_PACKAGE_LINUX_FIRMWARE_BRCM_BCM43XX=y           # brcmfmac SDIO blobs (AP6212/43430/43438 etc.)
BR2_PACKAGE_LINUX_FIRMWARE_BRCM_BCM43XXX=y          # brcmfmac SDIO blobs (AP6256/43455 etc.)
BR2_PACKAGE_WIRELESS_REGDB=y                        # regulatory.db (avoids the boot 'failed to load' warn)
BR2_PACKAGE_WPA_SUPPLICANT=y
BR2_PACKAGE_WPA_SUPPLICANT_CLI=y

# --- Our app ----------------------------------------------------------------
BR2_PACKAGE_ARTLYNK_VIEW=y
BR2_PACKAGE_UVC_GADGET=y                            # userspace UVC feeder (uvcsink won't drive our gadget)
```

## bridge/package/artlynk-view/Config.in
```kconfig
config BR2_PACKAGE_ARTLYNK_VIEW
	bool "artlynk-view"
	depends on BR2_PACKAGE_GSTREAMER1
	help
	  ArtLynk bridge viewer. Waits for the goggle's venc8 H.265 tap
	  (tcp://10.55.0.1:9000), decodes it (Amlogic V4L2 HEVC, or software
	  fallback) and renders straight to KMS/DRM on HDMI. Reconnects forever.

	  https://github.com/  (this repo's bridge/)
```

## bridge/package/uvc-gadget/Config.in
```kconfig
config BR2_PACKAGE_UVC_GADGET
	bool "uvc-gadget"
	help
	  Userspace UVC gadget daemon (wlhe fork): pumps MJPEG/YUYV frames into
	  a configfs f_uvc gadget and answers the UVC control events
	  (probe/commit/streamon), so a USB host sees a working webcam. Has a
	  built-in dummy/test-pattern mode (-d) and can take MJPEG from a file
	  (-i) or a V4L2 capture device (-v). We use it because GStreamer's
	  uvcsink won't negotiate our hand-built configfs gadget.

	  https://github.com/wlhe/uvc-gadget
```
